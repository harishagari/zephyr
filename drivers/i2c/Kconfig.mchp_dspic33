## drivers/i2c/Kconfig.mchp_dspic33
```kconfig
# Copyright (c) 2025 Microchip Technology Inc.
# SPDX-License-Identifier: Apache-2.0

config I2C_MCHP_DSPIC33
	bool "Microchip dsPIC33 I2C driver"
	default y
	depends on DT_HAS_MICROCHIP_DSPIC33_I2C_ENABLED
	help
	  Enable I2C host and client driver for Microchip dsPIC33 family
	  microcontrollers. Supports standard (100 kHz), fast (400 kHz),
	  and fast-plus (1 MHz) bus speeds.

if I2C_MCHP_DSPIC33

config I2C_MCHP_DSPIC33_TRANSFER_TIMEOUT
	int "dsPIC33 I2C transfer timeout [ms]"
	default 500
	help
	  Timeout in milliseconds for I2C transfer operations.

endif # I2C_MCHP_DSPIC33
```

## dts/bindings/i2c/microchip,dspic33-i2c.yaml
```yaml
# Copyright (c) 2025 Microchip Technology Inc.
# SPDX-License-Identifier: Apache-2.0

description: Microchip dsPIC33 I2C controller

compatible: "microchip,dspic33-i2c"

include: [i2c-controller.yaml, pinctrl-device.yaml]

properties:
  reg:
    required: true

  interrupts:
    required: true

  pinctrl-0:
    required: true

  pinctrl-names:
    required: true

  scl-gpios:
    type: phandle-array
    description: |
      GPIO spec for the SCL pin. Used for bus recovery by
      bit-banging SCL to unstick slaves holding SDA low.

  sda-gpios:
    type: phandle-array
    description: |
      GPIO spec for the SDA pin. Used for bus recovery to
      monitor SDA state during SCL toggling.
```

## tests/drivers/i2c/i2c_api/Kconfig
```kconfig
# Copyright (c) 2024 Renesas Electronics Corporation
# SPDX-License-Identifier: Apache-2.0

mainmenu "I2C API Test"

source "Kconfig.zephyr"

choice
	prompt "Select GY271 Sensor Type"
	default SENSOR_GY271_HMC

	config SENSOR_GY271_HMC
		bool "Use gy271 HMC type sensor"
		help
		  Use to enable the use of gy271 HMC sensor

	config SENSOR_GY271_QMC
		bool "Use gy271 QMC5883L type sensor (addr 0x0D)"
		help
		  Use to enable the use of gy271 QMC5883L sensor

	config SENSOR_GY271_QMC_P
		bool "Use gy271 QMC5883P type sensor (addr 0x2C)"
		help
		  Use to enable the use of gy271 QMC5883P sensor

endchoice
```

## tests/drivers/i2c/i2c_dspic33/testcase.yaml
```yaml
common:
  tags:
    - drivers
    - i2c
  depends_on:
    - i2c

tests:
  drivers.i2c.dspic33.api:
    platform_allow:
      - dspic33a_curiosity/p33ak512mps512
      - dspic33a_curiosity/p33ak128mc106
      - dspic33a_curiosity/p33ak256mps306
    harness: ztest
```
